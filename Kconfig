## Kconfig
```kconfig
menu "Framebuffer-less WS2812 driver"

    config ESP2812FBLESS_CUSTOM_RINGBUF
        bool "Use a custom ring buffer implementation"
        default y
        help
            Use a built-in custom ring buffer implementation (recommended).
            It works more efficiently than the generic ring buffer in ESP-IDF.

    config ESP2812FBLESS_TX_BUFFER_THRESHOLD
        int "The threshold to trigger TX buffer refill (2-8)"
        range 2 8
        default 2
        help
            Setting a lower value allows the refill interrupt to trigger less often
            and each refill works on a larger number of pixels, hence better efficiency.
            However, it is more prone to buffer underflow and flicking, especially when
            WiFi is enabled.

            Use a larger value if you experience excessive rendering glitches.

    choice
        prompt "Default pixel color format"
        default ESP2812FBLESS_PIXEL_GRB888
        help
            Default LED pixel color format.
            Can be changed at runtime during driver setup.

        config ESP2812FBLESS_PIXEL_RGB888
            bool "RGB888"
            help
                8 bit colors [Red, Green, Blue]
        
        config ESP2812FBLESS_PIXEL_RBG888
            bool "RBG888"
            help
                8 bit colors [Red, Blue, Green]

        config ESP2812FBLESS_PIXEL_GRB888
            bool "GRB888"
            help
                8 bit colors [Green, Red, Blue]

        config ESP2812FBLESS_PIXEL_GBR888
            bool "GBR888"
            help
                8 bit colors [Green, Blue, Red]

        config ESP2812FBLESS_PIXEL_BRG888
            bool "BRG888"
            help
                8 bit colors [Blue, Red, Green]

        config ESP2812FBLESS_PIXEL_BGR888
            bool "BGR888"
            help
                8 bit colors [Blue, Green, Red]

    endchoice

    choice
        prompt "Alpha blending mode"
        default ESP2812FBLESS_ALPHA_BLEND_STRAIGHT
        help
            Configure how translucent pixels (i.e. having an alpha channel) are blended.
            - Use straight blending for the best visual. But it may not be able to support
            certain filtering operations that might be added in the future;
            - Premultiplied blending can support more filtering operations, but it would likely
            be slower, *and* incurs more visual defects.

        config ESP2812FBLESS_ALPHA_BLEND_STRAIGHT
            bool "Straight blending"
            help
                Translucent pixels are blended directly with the background.
                This option produces the best visual. But it may not be able to support
                certain filtering operations that might be added in the future.

                This is currently the preferred option.
        
        config ESP2812FBLESS_ALPHA_BLEND_PREMULT_10B
            bool "Premultiplied (10-bit)"
            help
                Translucent pixels are pre-multiplied, then blended with the background.
                This option is the slowest, but it preserves 10-bit color info which reduces
                rounding errors during blending, and hence produces less visual defects.

        config ESP2812FBLESS_ALPHA_BLEND_PREMULT_8B
            bool "Premultiplied (8-bit)"
            help
                Translucent pixels are pre-multiplied, then blended with the background.
                This option is faster than 10-bit pre-multiplied, but it will produce a lot
                more rounding errors, thus visual defects, especially at low opacity values.

    endchoice

    config ESP2812FBLESS_ALPHA_BLEND_NO_DIV
        bool "Use optimized blending algorithm (avoids division)"
        default y
        help
            Use optimized blending algorithm (recommended).
            It avoids using divisions, so would run faster than the standard algorithm.
            Should produce identical results.

endmenu
```
